global &project
&project="mt6571v1_evb_emmc"
