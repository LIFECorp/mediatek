 &NR_CPUS=1
;if RAM_BOOT == 0, load symbol only, use /no_code
;if RAM_BOOT == 1, load elf
 &RAM_BOOT=0
;if OPT_JTAG == 0, parallel JTAG
;if OPT_JTAG == 1, serial JTAG
 &OPT_JTAG=1

system.reset
SYSTEM.OPTION ENRESET ON
SYStem.Option ResBreak OFF
SYStem.Option WaitReset OFF
SYStem.JtagClock 10.MHz
if &NR_CPUS==1
(
SYSTEM.CPU CortexA7MPCore
)
else
(
    SYStem.CPU CortexA7MPCore
)

if &NR_CPUS==1
(

    ;Setting Core debug register access
    SYStem.CONFIG CORENUMBER 1;
    SYSTEM.MULTICORE COREBASE 0x80070000
)
else
(

;Setting Core debug register access
	SYSTEM.CONFIG CORENUMBER 2;
	core.assign 1 2
    SYSTEM.MULTICORE COREBASE 0x80070000 0x80072000;
)

;if OPT_JTAG == 0, parallel JTAG
;if OPT_JTAG == 1, serial JTAG
IF &OPT_JTAG==0
(
System.CONFIG SWDP OFF
)
ELSE IF &OPT_JTAG==1
(
System.CONFIG SWDP ON
)


SYStem.Up
;wait 200.us

; disable DABORT and PABORT breakpoint
tronchip.set dabort off
tronchip.set pabort off
tronchip.set undef off
tronchip.set irq off

; board init
;if &RAM_BOOT==1
;(
;	do MT6572_PLL_Init.cmm 200
;	do MT6572_EMI_Init.cmm LPDDR2-400
;)



; disable wdt (debug purpose)
D.S SD:0x10007400 %LE %LONG 0x22000000
; set L2 as share memory (128 KB, Preloader is placed in L2)
D.S SD:0x10200000 %LE %LONG 0x00000000
;set longer delay when second load cmm, ROM will delay longer (enable MMU later)
;D.S SD:0x11143350    %LE %LONG 0x4A544147
;D.S SD:0x11143354   %LE %LONG 0x444C4159
;D.S SD:0x11143358   %LE %LONG 20000
D.S C15:0x01 0				; Turn off MMU
;D.S SD:0x10001E84 %LE %LONG 0x00000500
;D.S SD:0x10001E88 %LE %LONG 0x00000500
;Switch DB tool pad mux
;D.S SD:0x100053B0  %LE %LONG 0x20000000
;D.S SD:0x100053C0  %LE %LONG 0x00000002

; board init
print "loading pre-loader image"
if &RAM_BOOT==1
(
;d.load.elf ../../preloader_mt6571_fpga.elf /gnu /RELPATH /PATH "../../../platform/mt6571/preloader/src/init" /PATH "../../../platform/mt6571/preloader/src/core" /PATH "../../../platform/mt6571/preloader/src/drivers" /PATH "../../../platform/mt6571/preloader/src/security" /PATH "../../../custom/mt6571_fpga/preloader"
;d.load.elf ../../preloader_mt6571v1_evb_emmc.elf
d.load.elf ../../../../out/target/product/mt6571v1_evb_emmc/obj/PRELOADER_OBJ/bin/preloader.elf
;d.load.elf ../../preloader_mt6571v1_evb_emmc_TINY.elf
;d.load.elf ../../preloader_mt6571v1_evb_emmc_CTP.elf
;d.load.elf ../../bin/preloader_mt6571_fpga.elf
;d.load.elf ../../bin/preloader_mt6571_fpga_TINY.elf
;d.load.elf ../../preloader_mt6571_fpga_CTP.elf
;d.load.elf ../../preloader_mt6571_fpga_DUMMY_AP.elf
)
ELSE IF &RAM_BOOT==0
(
d.load.elf ../../../../out/target/product/mt6571v1_evb_emmc/obj/PRELOADER_OBJ/bin/preloader.elf /nocode
;d.load.elf ../../preloader_mt6571v1_evb_emmc.elf /nocode
)

; Download flag
;*USBDL_FLAG=1; //enter BOOTROM USBDL by flag
;*USBDL_MAGIC_REG=0x55534244; //fill in BOOTROM USBDL by flag magic number
;D.S SD:0x1000141C %LE %LONG 0x1
;D.S SD:0x10001420 %LE %LONG 0x55534244


; for memory preserved mode
;do MT6571_FPGA_SDR.cmm
;print "loading logo image"
;&mem_pre_addr=0x80000000;
;.load.binary ../../mem_preloader_mt6571_fpga.bin &mem_pre_addr
;.load.elf ../../sram_preloader_mt6571_fpga.elf
;d.load.elf ../../mem_preloader_mt6571_fpga.elf

;may not alway use hw breakpoint both in parallel and serial JTAG
IF &OPT_JTAG==1
(
Break.Select Program OnChip
Break.Select Hll OnChip
Break.Select Spot OnChip
Break.Select Read OnChip
Break.Select Write OnChip
)

Y.SPATH.RESET ; reset all source path
Y.SPATH.SRD ../../../platform/mt6571/preloader/src/init
Y.SPATH.SRD ../../../platform/mt6571/preloader/src/core
Y.SPATH.SRD ../../../platform/mt6571/preloader/src/drivers
Y.SPATH.SRD ../../../platform/mt6571/preloader/src/security
Y.SPATH.SRD ../../../custom/mt6571_fpga/preloader

;d.s c:0x10208000 %le %long 0xe
;d.s c:0x10208100 %le %long 0x1
;d.s c:0x10208200 %le %long 0x1

;core.select 1
;r.s pc 0x40

;core.select 0
;enable GPT4
;d.s c:0x10008040 %le %long 0x000000001
;d.l
;b.s main
D.S C15:0x01 0				; Turn off MMU
enddo
